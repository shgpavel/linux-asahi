## Documentation/devicetree/bindings/phy/apple,dptx-phy.yaml
```yaml
# SPDX-License-Identifier: (GPL-2.0-only OR BSD-2-Clause)
%YAML 1.2
---
$id: http://devicetree.org/schemas/phy/apple,dptx-phy.yaml#
$schema: http://devicetree.org/meta-schemas/core.yaml#

title: Apple DisplayPort TX PHY

maintainers:
  - Janne Grunau <j@jannau.net>

description:
  The DisplayPort TX PHY drives the DisplayPort link of a display coprocessor
  (DCP) on Apple Silicon SoCs. On desktop machines it feeds the on-board
  DisplayPort to HDMI converter behind the HDMI port.

properties:
  compatible:
    oneOf:
      - items:
          - enum:
              - apple,t6020-dptx-phy
              - apple,t8112-dptx-phy
          - const: apple,dptx-phy
      - items:
          - const: apple,t8132-dptx-phy
          - const: apple,t8122-dptx-phy
      - const: apple,t8122-dptx-phy

  reg:
    items:
      - description: Common controls, the DCP input select and PLL shadow update
      - description: PHY controls, PLL, impedance calibration and lanes

  reg-names:
    items:
      - const: core
      - const: dptx

  power-domains:
    maxItems: 1

  "#phy-cells":
    const: 0

  "#reset-cells":
    const: 0

required:
  - compatible
  - reg
  - reg-names
  - power-domains
  - "#phy-cells"

additionalProperties: false

examples:
  - |
    soc {
        #address-cells = <2>;
        #size-cells = <2>;

        phy@39a700000 {
            compatible = "apple,t8132-dptx-phy", "apple,t8122-dptx-phy";
            reg = <0x3 0x9a700000 0x0 0x4000>,
                  <0x3 0x9a740000 0x0 0x10000>;
            reg-names = "core", "dptx";
            power-domains = <&ps_dptx_phy>;
            #phy-cells = <0>;
            #reset-cells = <0>;
        };
    };
```

## Documentation/devicetree/bindings/sound/apple,t8132-mca.yaml
```yaml
# SPDX-License-Identifier: (GPL-2.0-only OR BSD-2-Clause)
%YAML 1.2
---
$id: http://devicetree.org/schemas/sound/apple,t8132-mca.yaml#
$schema: http://devicetree.org/meta-schemas/core.yaml#

title: Apple M4 MCA I2S transceiver

description: |
  The MCA on the Apple M4 (t8132) has the clusters of the older MCA split
  into arrays: six clock blocks (MCLK configuration, sync generator, port),
  17 receive and 17 transmit SERDES units and 17 DMA FIFOs, plus a block that
  starts and stops SERDES units in groups. Each clock block takes its MCLK from
  a PMGR mux selecting one of a set of fixed-rate sources.

maintainers:
  - Pavel Shago <pavel@shago.dev>

allOf:
  - $ref: dai-common.yaml#

properties:
  compatible:
    const: apple,t8132-mca

  reg:
    items:
      - description: Group start block, clock blocks, SERDES units and DMA FIFOs
      - description: MCLK source muxes of the six clock blocks

  dmas:
    maxItems: 12
    description:
      DMA channels of the six clusters, transmit then receive for each.

  dma-names:
    items:
      - const: tx0
      - const: rx0
      - const: tx1
      - const: rx1
      - const: tx2
      - const: rx2
      - const: tx3
      - const: rx3
      - const: tx4
      - const: rx4
      - const: tx5
      - const: rx5

  resets:
    maxItems: 1

  power-domains:
    items:
      - description: Power domain for register access
      - description: Cluster 0
      - description: Cluster 1
      - description: Cluster 2
      - description: Cluster 3
      - description: Cluster 4
      - description: Cluster 5

  '#sound-dai-cells':
    const: 1

required:
  - compatible
  - reg
  - dmas
  - dma-names
  - power-domains
  - '#sound-dai-cells'

unevaluatedProperties: false

examples:
  - |
    mca: i2s@93600000 {
      compatible = "apple,t8132-mca";
      reg = <0x93600000 0x9100>,
            <0x88240038 0x18>;

      resets = <&ps_audio_p>;
      power-domains = <&ps_audio_leap_mca>, <&ps_audio_mca0_m>,
                      <&ps_audio_mca1_m>, <&ps_audio_mca2_m>,
                      <&ps_audio_mca3_m>, <&ps_audio_mca4_m>,
                      <&ps_audio_mca5_m>;
      dmas = <&admac 0>, <&admac 1>, <&admac 2>, <&admac 3>,
             <&admac 4>, <&admac 5>, <&admac 6>, <&admac 7>,
             <&admac 8>, <&admac 9>, <&admac 10>, <&admac 11>;
      dma-names = "tx0", "rx0", "tx1", "rx1", "tx2", "rx2",
                  "tx3", "rx3", "tx4", "rx4", "tx5", "rx5";

      #sound-dai-cells = <1>;
    };
```
